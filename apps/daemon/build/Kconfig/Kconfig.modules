## apps/daemon/build/Kconfig/Kconfig.modules
```kconfig
menu "hal_nordic (/usr/local/src/zephyros/modules/hal/nordic)"
osource "$(ZEPHYR_HAL_NORDIC_KCONFIG)"
config ZEPHYR_HAL_NORDIC_MODULE
	bool
	default y
endmenu
menu "sof (/usr/local/src/zephyros/modules/audio/sof)"
osource "/usr/local/src/zephyros/modules/audio/sof/zephyr/Kconfig"
config ZEPHYR_SOF_MODULE
	bool
	default y
endmenu
menu "trusted-firmware-m (/usr/local/src/zephyros/modules/tee/tfm)"
osource "$(ZEPHYR_TRUSTED_FIRMWARE_M_KCONFIG)"
config ZEPHYR_TRUSTED_FIRMWARE_M_MODULE
	bool
	default y
endmenu
menu "nanopb (/usr/local/src/zephyros/modules/lib/nanopb)"
osource "$(ZEPHYR_NANOPB_KCONFIG)"
config ZEPHYR_NANOPB_MODULE
	bool
	default y
endmenu
menu "tensorflow (/usr/local/src/zephyros/modules/lib/tensorflow)"
osource "$(ZEPHYR_TENSORFLOW_KCONFIG)"
config ZEPHYR_TENSORFLOW_MODULE
	bool
	default y
endmenu
menu "ipm (/Users/zhangtao/Projects/zephyr/drivers/ipm)"
osource "/Users/zhangtao/Projects/zephyr/drivers/ipm/Kconfig"
config ZEPHYR_IPM_MODULE
	bool
	default y
endmenu
```

## apps/daemon/build/Kconfig/Kconfig.shield
```kconfig
osource "/Users/zhangtao/Projects/zephyr/boards/shields/*/Kconfig.shield"
osource "/usr/local/src/zephyros/zephyr/boards/shields/*/Kconfig.shield"
```

## apps/daemon/build/Kconfig/Kconfig.soc.arch
```kconfig
osource "/usr/local/src/zephyros/zephyr/soc/$(ARCH)/Kconfig"
osource "/usr/local/src/zephyros/zephyr/soc/$(ARCH)/*/Kconfig"
```

## apps/nucleo/build/Kconfig/Kconfig.shield.defconfig
```kconfig
osource "/Users/zhangtao/Projects/zephyr/boards/shields/*/Kconfig.defconfig"
osource "/usr/local/src/zephyros/zephyr/boards/shields/*/Kconfig.defconfig"
```

## boards/arm/bearpi-l431rc/Kconfig.board
```kconfig
# STM32L431RC BearPi board configuration

# Copyright (c) 2016 Open-RnD Sp. z o.o.
# Copyright (c) 2016 BayLibre, SAS
# SPDX-License-Identifier: Apache-2.0

config BOARD_BEARPI_L431RC
	bool "HW L431RC Development Board"
	depends on SOC_STM32L431XX
```

## boards/arm/bearpi_l431rc/Kconfig.defconfig
```kconfig
# STM32L432KC Nucleo board configuration

# Copyright (c) 2016 Open-RnD Sp. z o.o.
# Copyright (c) 2016 BayLibre, SAS
# SPDX-License-Identifier: Apache-2.0

if BOARD_BEARPI_L431RC

config BOARD
	default "bearpi_l431rc"

endif # BOARD_BEARPI_L431RC
```

## boards/arm/disco_l496ag/Kconfig.board
```kconfig
# Disco STM32L496AG board configuration

# Copyright (c) 2016 Open-RnD Sp. z o.o.
# Copyright (c) 2016 BayLibre, SAS
# Copyright (c) 2019 Centaur Analytics, Inc
# SPDX-License-Identifier: Apache-2.0

config BOARD_DISCO_L496AG
	bool "Disco L496AG Development Board"
	depends on SOC_STM32L496XX
```

## boards/arm/disco_l496ag/Kconfig.defconfig
```kconfig
# STM32L476G Nucleo board configuration

# Copyright (c) 2016 Open-RnD Sp. z o.o.
# Copyright (c) 2016 BayLibre, SAS
# SPDX-License-Identifier: Apache-2.0

if BOARD_DISCO_L496AG

config BOARD
	default "disco_l496ag"

endif # BOARD_DISCO_L496AG
```

## boards/arm/disco_l496ag/disco_l496ag_defconfig
```kconfig
# SPDX-License-Identifier: Apache-2.0

CONFIG_SOC_SERIES_STM32L4X=y
CONFIG_SOC_STM32L496XX=y
# 80MHz system clock
CONFIG_SYS_CLOCK_HW_CYCLES_PER_SEC=80000000

# Enable MPU
CONFIG_ARM_MPU=y

# Enable HW stack protection
CONFIG_HW_STACK_PROTECTION=y

# enable uart driver
CONFIG_SERIAL=y

# enable pinmux
CONFIG_PINMUX=y

# enable GPIOs
CONFIG_GPIO=y

# clock configuration
CONFIG_CLOCK_CONTROL=y
# SYSCLK selection
CONFIG_CLOCK_STM32_SYSCLK_SRC_PLL=y
# PLL configuration
CONFIG_CLOCK_STM32_PLL_SRC_HSI=y
# produce 80MHz clock at PLL output
CONFIG_CLOCK_STM32_PLL_M_DIVISOR=1
CONFIG_CLOCK_STM32_PLL_N_MULTIPLIER=20
CONFIG_CLOCK_STM32_PLL_P_DIVISOR=7
CONFIG_CLOCK_STM32_PLL_Q_DIVISOR=2
CONFIG_CLOCK_STM32_PLL_R_DIVISOR=4
CONFIG_CLOCK_STM32_AHB_PRESCALER=1
CONFIG_CLOCK_STM32_APB1_PRESCALER=1
CONFIG_CLOCK_STM32_APB2_PRESCALER=1

# console
CONFIG_CONSOLE=y
CONFIG_UART_CONSOLE=y


#QSPI Flash
CONFIG_FLASH=y
CONFIG_FLASH_STM32_QSPI=y
CONFIG_FILE_SYSTEM=y
CONFIG_FILE_SYSTEM_LITTLEFS=y
CONFIG_FLASH_MAP=y

#SDMMC1
CONFIG_DISK_ACCESS=y
CONFIG_DISK_DRIVERS=y
CONFIG_DISK_DRIVER_SDMMC=y
CONFIG_SDMMC_STM32=y
CONFIG_FAT_FILESYSTEM_ELM=y
```

## boards/arm/nucleo_wl55jc2/Kconfig.board
```kconfig
# STM32WL55JC Nucleo board configuration

# Copyright (c) 2020 STMicroelectronics
# SPDX-License-Identifier: Apache-2.0

config BOARD_NUCLEO_WL55JC2_CM0
	bool "Nucleo WL55JC2 Development Board with M0PLUS Core"
	depends on SOC_STM32WL55XX
	select CPU_CORTEX_M0PLUS
    select USE_STM32_HAL_GPIO
    select USE_STM32_HAL_SUBGHZ
    select USE_STM32_HAL_CORTEX
    select PM

config BOARD_NUCLEO_WL55JC2_CM4
	bool "Nucleo WL55JC2 Development Board with M4 Core"
	depends on SOC_STM32WL55XX
	select CPU_CORTEX_M4
	select USE_STM32_HAL_CORTEX
	select USE_STM32_HAL_PWR_EX
```

## boards/arm/nucleo_wl55jc2/Kconfig.defconfig
```kconfig
# STM32WL55JC Nucleo board configuration

# Copyright (c) 2020 STMicroelectronics
# SPDX-License-Identifier: Apache-2.0

if BOARD_NUCLEO_WL55JC2_CM0 || BOARD_NUCLEO_WL55JC2_CM4
	config BOARD
		default "nucleo_wl55jc2_cm0" if BOARD_NUCLEO_WL55JC2_CM0
		default "nucleo_wl55jc2_cm4" if BOARD_NUCLEO_WL55JC2_CM4
		choice STM32_RTC_CLOCK
        	default STM32_RTC_CLOCK_LSE
        	depends on STM32_RTC_TIMER
		endchoice

endif # BOARD_NUCLEO_WL55JC2_M0 || BOARD_NUCLEO_WL55JC2_M4
```

## boards/arm/nucleo_wl55jc2/nucleo_wl55jc2_cm0_defconfig
```kconfig
CONFIG_SOC_SERIES_STM32WLX=y
CONFIG_SOC_STM32WL55XX=y
# 48MHz system clock

# enable uart driver
CONFIG_SERIAL=y

# enable pinmux
CONFIG_PINMUX=y

# enable GPIO
CONFIG_GPIO=y

# clock configuration
CONFIG_CLOCK_CONTROL=y


CONFIG_IPM_STM32_IPCC2=y
CONFIG_IPM_STM32_IPCC2_PROCID=2

# console
CONFIG_CONSOLE=y
CONFIG_UART_CONSOLE=y

# Enable MPU
CONFIG_ARM_MPU=y
```

## boards/arm/nucleo_wl55jc2/nucleo_wl55jc2_cm4_defconfig
```kconfig
CONFIG_SOC_SERIES_STM32WLX=y
CONFIG_SOC_STM32WL55XX=y

# enable uart driver
CONFIG_SERIAL=y

# enable pinmux
CONFIG_PINMUX=y

# enable GPIO
CONFIG_GPIO=y

# clock configuration
CONFIG_CLOCK_CONTROL=y

# console
CONFIG_CONSOLE=y
CONFIG_UART_CONSOLE=y

#Enable ipm driver
CONFIG_IPM_STM32_IPCC2=y
CONFIG_IPM_STM32_IPCC2_PROCID=1

CONFIG_SYS_CLOCK_TICKS_PER_SEC=1024
```

## boards/arm/nucleo_wl55jc2m0/Kconfig.defconfig
```kconfig
# STM32WL55JC Nucleo board configuration

# Copyright (c) 2020 STMicroelectronics
# SPDX-License-Identifier: Apache-2.0

if BOARD_NUCLEO_WL55JC2

config BOARD
	default "nucleo_wl55jc2"

endif # BOARD_NUCLEO_WL55JC2
```

## boards/arm/nucleo_wl55jc2m4/Kconfig.board
```kconfig
# STM32WL55JC Nucleo board configuration

# Copyright (c) 2020 STMicroelectronics
# SPDX-License-Identifier: Apache-2.0

config BOARD_NUCLEO_WL55JC2M4
	bool "Nucleo WL55JC2 Development Board with M4 Core"
	depends on SOC_STM32WL55XX
	select USE_STM32_HAL_GPIO
	select CPU_HAS_FPU
	select USE_STM32_HAL_SUBGHZ
	select USE_STM32_HAL_CORTEX
```

## drivers/ipm/Kconfig
```kconfig
# ST7789V2 display driver configuration options

# Copyright (c) 2019 Marc Reilly <marc@cpdesign.com.au>
# SPDX-License-Identifier: Apache-2.0

menuconfig IPM_STM32_IPCC2
	bool "STM32 IPCC IPM driver"
	help
	  Enable ipm driver for stm32 ipcc.
	
if IPM_STM32_IPCC2
	config IPM_STM32_IPCC2_PROCID
    	int "STM32 IPCC Processor ID"
        default 1
        range 1 2
        help
			use to define the Processor ID for IPCC access
endif
```

## drivers/st7789v2/Kconfig
```kconfig
# ST7789V2 display driver configuration options

# Copyright (c) 2019 Marc Reilly <marc@cpdesign.com.au>
# SPDX-License-Identifier: Apache-2.0

menuconfig ST7789V2
	bool "ST7789V2 display driver"
	depends on SPI
	help
	  Enable driver for ST7789V2 display driver.

endchoice
```

## drivers/st7789v2/dts/bindings/sitronix,st7789v2.yaml
```yaml
# Copyright (c) 2019, Marc Reilly <marc@cpdesign.com.au>
# Copyright (c) 2019, PHYTEC Messtechnik GmbH
# SPDX-License-Identifier: Apache-2.0

description: ST7789V2 240x240 display controller

compatible: "sitronix,st7789v2"

include: spi-device.yaml

properties:
    power-gpios:
      type: phandle-array
      required: false
      description: power pin.

        The power pin of ST7789V is active low (transmission command byte).
        If connected directly the MCU pin should be configured
        as active low.

    reset-gpios:
      type: phandle-array
      required: true
      description: RESET pin.

        The RESET pin of ST7789V is active low.
        If connected directly the MCU pin should be configured
        as active low.

    cmd-data-gpios:
      type: phandle-array
      required: true
      description: D/CX pin.

        The D/CX pin of ST7789V is active low (transmission command byte).
        If connected directly the MCU pin should be configured
        as active low.

    height:
      type: int
      required: true
      description: Height in pixels of the panel driven by the controller

    width:
      type: int
      required: true
      description: Width in pixels of the panel driven by the controller

    x-offset:
      type: int
      required: true
      description: The column offset in pixels of the LCD to the controller memory

    y-offset:
      type: int
      required: true
      description: The row offset in pixels of the LCD to the controller memory

    vcom:
      type: int
      required: true
      description: VCOM Setting

    gctrl:
      type: int
      required: true
      description: Gate Control

    vrhs:
      type: int
      required: false
      description: VRH Setting

    vdvs:
      type: int
      required: false
      description: VDV Setting

    mdac:
      type: int
      required: true
      description: Memory Data Access Control

    lcm:
      type: int
      required: true
      description: LCM Setting

    colmod:
      type: int
      required: true
      description: Interface Pixel Format

    porch-param:
      type: uint8-array
      required: true
      description: Porch Setting

    pwctrl1-param:
      type: uint8-array
      required: true
      description: Power Control 1 Parameter

    pvgam-param:
      type: uint8-array
      required: true
      description: Positive Voltage Gamma Control Parameter

    nvgam-param:
      type: uint8-array
      required: true
      description: Negative Voltage Gamma Control Parameter
```

## drivers/stm32_fmc_sram/Kconfig
```kconfig
# Copyright (c) 2020 Teslabs Engineering S.L.
# SPDX-License-Identifier: Apache-2.0

config STM32_FMC_SRAM
	bool "Enable STM32 Flexible Memory Controller (FMC)"
	depends on CONFIG_SOC_SERIES_STM32L4X
	default $(dt_compat_enabled,$(DT_COMPAT_ST_STM32_FMC_SDRAM))
	select USE_STM32_LL_FMC
	help
	  Enable STM32 Flexible Memory Controller.

module = STM32_FMC_SRAM
module-str = fmc_sram
source "subsys/logging/Kconfig.template.log_config"
DT_COMPAT_ST_STM32_FMC_SDRAM := st,stm32-fmc-sram
```

## drivers/timer/Kconfig
```kconfig
# ST7789V2 display driver configuration options

# Copyright (c) 2019 Marc Reilly <marc@cpdesign.com.au>
# SPDX-License-Identifier: Apache-2.0

menuconfig STM32_RTC_TIMER
	bool "STM32 Low Power Timer [EXPERIMENTAL]"
        depends on (SOC_SERIES_STM32L4X || SOC_SERIES_STM32L5X || SOC_SERIES_STM32WBX || SOC_SERIES_STM32WLX)
        depends on CLOCK_CONTROL && PM
        select TICKLESS_CAPABLE
        help
          This module implements a kernel device driver for the LowPower Timer
          and provides the standard "system clock driver" interfaces.
	
if STM32_RTC_TIMER
choice STM32_RTC_CLOCK
        prompt "LPTIM clock value configuration"

config STM32_RTC_CLOCK_LSE
        bool "LSE"
        help
          Use LSE as RTC clock

config STM32_RTC_CLOCK_LSI
        bool "LSI"
        help
          Use LSI as RTC clock
endchoice

endif
```

## drivers/timer/Kconfig.stm32_rtc
```kconfig
# Copyright (c) 2018 Foundries.io Ltd
# Copyright (c) 2019 STMicroelectronics
# Copyright (c) 2021 Skyarm Technologies
# SPDX-License-Identifier: Apache-2.0

menuconfig STM32_RTC_TIMER
        bool "STM32 RTC Timer"
        depends on (SOC_SERIES_STM32L4X || SOC_SERIES_STM32L5X \
                || SOC_SERIES_STM32WBX || SOC_SERIES_STM32WLX)
        depends on CLOCK_CONTROL
        select TICKLESS_CAPABLE
        help
          This module implements a kernel device driver for the accurate and 
          low power wakeup timer, and provides the standard "system clock driver" 
          interfaces.
	
if STM32_RTC_TIMER
choice STM32_RTC_CLOCK
        prompt "LPTIM clock value configuration"

config STM32_RTC_CLOCK_LSE
        bool "LSE clock"
        help
          Use LSE clock as RTC clock

config STM32_RTC_CLOCK_LSI
        bool "LSI clock"
        help
          Use LSI clock as RTC clock
endchoice

endif
```

## soc/arm/st_stm32/stm32wl/Kconfig.series
```kconfig
# STMicroelectronics STM32WL MCU series

# Copyright (c) 2020 STMicroelectronics.
# SPDX-License-Identifier: Apache-2.0

config SOC_SERIES_STM32WLX
	bool "STM32WLx Series MCU"
	select ARM
	select SOC_FAMILY_STM32
	select CPU_HAS_ARM_MPU
	select HAS_STM32CUBE
	help
	  Enable support for STM32WL MCU series
```

## soc/arm/st_stm32/stm32wl/Kconfig.soc
```kconfig
# STMicroelectronics STM32WL MCU line

# Copyright (c) 2020 STMicroelectronics.
# SPDX-License-Identifier: Apache-2.0

choice
	prompt "STM32WLx MCU Selection"
	depends on SOC_SERIES_STM32WLX

config SOC_STM32WL55XX
	bool "STM32WL55XX"
	select CPU_HAS_FPU if CPU_CORTEX_M4
        select CPU_CORTEX_M_HAS_DWT if CPU_CORTEX_M4
	select CPU_CORTEX_M_HAS_SYSTICK if CPU_CORTEX_M0PLUS
	select CPU_CORTEX_M_HAS_VTOR if CPU_CORTEX_M0PLUS

endchoice
```
